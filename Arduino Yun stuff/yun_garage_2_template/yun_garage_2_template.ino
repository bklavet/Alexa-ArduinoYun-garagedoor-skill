///////////////////////////////////////////////////////////////////////////////////////////////////////////////////////////////////  
// NEARBUS LIBRARY - www.nearbus.net        
// File:        Hello_world.ino
// Description: Hello World Example
// Platform:    Arduino YUN
// Status:      Alpha Release
// Author:      F. Depalma
// Support:     info@nearbus.net
///////////////////////////////////////////////////////////////////////////////////////////////////////////////////////////////////  
// REVISION HISTORY
// v0.20 - 08-02-13 - Initial Release
// v0.21 - 25-04-13 - This release includes support for Arduino Mega 128 and 256 (ADC function)  - Contributor: Peter Huff  
// v0.3L - 02-05-13 - This release implements 32bits Registers  for TRNSP mode (Reg_A & Reg_B) and support for Google Connector
// v0.4L - 10-05-13 - This release includes support to: Ethernet, WiFi and GPRS Arduino shields.
// v0.5L - 29-06-13 - This release includes support for IP Static Addressing - Contributor: Craig  
// v0.6  - 02-08-13 - This release implement DNS Address Resolution and PULSE_OUTPUT NearBIOS function
// v0.7  - 20-08-13 - This release implements support for user defined functions (MY_NBIOS_0) 
// v0.9  - 17-09-13 - This release implements Enhanced Services (Alpha) - TriggerInput() - DigitalCounter() - RmsInput() and ResetPort()
// v0.10 - 05-11-13 - This release implements support for Arduino YUN (it requires IDE 1.5.4) and fixes some minors bugs
// v0.11 - 12-11-13 - This release fixes a BUG in the MY_NBIOS service.
// v0.12 - 28-11-13 - The RMS_INPUT service is modified to deliver a mV output value.
// v0.14 - 03-01-14 - Include supports for X-CONTROL
// v0.15 - 11-01-14 - Include supports for X-CONTROL V2
//
///////////////////////////////////////////////////////////////////////////////////////////////////////////////////////////////////  
//  AGENT CONFIGURATION PARAMETERS  ( You only need define this parameters )
//  IMPORTANT: this agent version is only supported on devices ID from NB100246 onwards
///////////////////////////////////////////////////////////////////////////////////////////////////////////////////////////////////  
char deviceId []    = "";   // Put here the device_ID generated by the NearHub ( NB1xxxxx )
char sharedSecret[] = "";   // The same as you configured in the NearHub (8 characters/number)  

///////////////////////////////////////////////////////////////////////////////////////////////////////////////////////////////////  

///////////////////////////////////////////////////////////////////////////////////////////
//  Includes
///////////////////////////////////////////////////////////////////////////////////////////
#include <NearbusYun_v15.h>											
#include <Bridge.h>
#include <YunClient.h>																					
#include <HttpClient.h>
#include <SPI.h>
#include <Servo.h>
#include <FlexiTimer2.h>

///////////////////////////////////////////////////////////////////////////////////////////
//  Global Variables               
/////////////////////////////////////////////////////////////////////////////////////////// 
Nearbus Agent(0);

ULONG A_register[8];                                                // Define the Tx Buffer (Reg_A)
ULONG B_register[8];                                                // Define the Rx Buffer (Reg_B) 
int retorno;

void AuxPortServices(void) {
    Agent.PortServices(); 
}


///////////////////////////////////////////////////////////////////////////////////////////////////////////////////////////////////  
//  BROWSER API REST COMMAND LINE (for JavaScript) - (use it for troubleshooting)
//
//  http://nearbus.net/v1/api_vmcu_jsb/NB100***?user=****&pass=****&channel=0&service=DIG_OUTPUT&value=1&method=POST&reqid=123456
//
//  user:          Your NearBus Web user
//  pass:          Your NearBus Web password
//  channel:       NearBus channel [0-3]
//  value:         Service value (if apply)
//  method:        GET (read) / POST (write)
//  reqid:         Transaction identifier (to match a request and its response)
// 
//  SUPPORTED API SERVICES
//  DIG_INPUT:     Digital Input - Input Range [0-1] - Method: GET 
//  DIG_OUTPUT:    Digital Output - Output Range [0-1] - Method: POST/GET 
//  ADC_INPUT:     ADC Analog Input - Output Range [0-1023] - Method: GET 
//  PULSE _OUTPUT: Digital Output - Input Range [0-65535] in steps of 10ms (max 655 seg) - Method: POST/GET 
//  PWM_OUTPUT:    PWM Output calibrated for Servomotors - Input Range [800-2200] - Method: POST/GET   
//  DIG_COUNTER:   Pulse Counter / Accumulator
//  RMS_INPUT:     True RMS Meter
//  MY_NBIOS_0:    User defined function
//
//  For a detailed information please go to: http://goo.gl/Gxrcua
//
///////////////////////////////////////////////////////////////////////////////////////////////////////////////////////////////////  


/*####################################################################################################################################
#######################################################################################################################################                                                                                                                                       ###
###          MY_NBIOS CUSTOM FUNCTION CODE---GARAGE DOOR RELAY                                                                                    ####                                                                                                     ###                                                                                                                               ###
#######################################################################################################################################
 ####################################################################################################################################*/  
void Nearbus::MyNbios_0( byte portId, ULONG setValue, ULONG* pRetValue, byte vmcuMethod, PRT_CNTRL_STRCT* pPortControlStruct )
{
  
    //************************************
    // Reconfiguring Ports as I/O
    //************************************
    if( pPortControlStruct->portMode != MYNBIOS_MODE ) 
    {
	    PortModeConfig( portId, MYNBIOS_MODE );        
    }

    //************************************
    // Custom Function
    //************************************
    // DEFAULT:      The default analog reference of 5 volts (on 5V Arduino boards) or 3.3 volts (on 3.3V Arduino boards)
    // INTERNAL:     An built-in reference, equal to 1.1 volts on the ATmega168 or ATmega328 and 2.56 volts on the ATmega8 (not available on the Arduino Mega)
    // INTERNAL1V1:  A built-in 1.1V reference (Arduino Mega only)
    // INTERNAL2V56: A built-in 2.56V reference (Arduino Mega only)
    // EXTERNAL:     The voltage applied to the AREF pin (0 to 5V only) is used as the reference. 	
	
	
    analogReference( DEFAULT );	
       
    *pRetValue = (ULONG) analogRead( pPortControlStruct->anaPinId );   
  
}

 int trigger = 0;

////////////////////////////////////////////////////////////////////// 
//   SETUP ROUTINE                                                                                 
//////////////////////////////////////////////////////////////////////                            
void setup(void)
{
         
    //*********************************
    // SERIAL INTERFACE INITIALIZATION
    //*********************************
    Serial.begin(9600);   // Start serial library
    Bridge.begin();
    HttpClient client;
    
    //*********************************
    // NEARBUS INITIALIZATION
    //*********************************  
    Agent.NearInit( deviceId, sharedSecret );

    //*********************************
    // FLEXITIMER INITIALIZATION
    //*********************************
	#if FLEXI_TIMER		
	    FlexiTimer2::set( INT_PERIOD, AuxPortServices );          // Call the port services routine every 10 ms
            FlexiTimer2::start();
	#endif   
    
	delay(1000);                                                  // Give the Ethernet shield a second to initialize

        pinMode(3, OUTPUT); 
        digitalWrite(3,HIGH);  
}

void loop()
{
   HttpClient client;
int ret; 
        
    Agent.NearChannel( A_register, B_register, &ret );

    if ( ret >= 50 )
    {
        //Serial.println( "Rx Error" ); 
        // [50]  Frame Autentication Mismatch
        // [51]  Frame Out of sequence
        // [52]  Remote ACK Error
        // [53]  Unsupported Command    
    }

/*
    ///////////////////////////////////
    // Example 1 - Analog Input        
    // Mode: TRNSP
    ///////////////////////////////////        
    A_register[0] = analogRead(0);                                // PIN A0
*/        


    ///////////////////////////////////
    // Example 2 - Digital Output
    // Mode: TRNSP
    ///////////////////////////////////        
    if( B_register[0] == 1){ 
        if (trigger == 0){
        digitalWrite( 3, LOW );
        Serial.println ("It Works!");
        delay(1000);
        digitalWrite( 3, HIGH );
        client.get("http://nearbus.net/v1/api_transp/NB101xxx?user=xxxxxxx&pass=xxxxxxxx&method=POST&reg00=0");
        while (client.available()) {
        char c = client.read();
        Serial.print(c);
  }
  Serial.flush();
  delay(2000);
    }
    }


/*        
    ///////////////////////////////////
    // Example 3 - PWM Analog Output
    // Mode: TRNSP
    ///////////////////////////////////                
    analogWrite( 3, B_register[0] );                              // PIN D3 - This function DO NOT works with Servo Motors and require an input from 0 to 255.
*/

}
